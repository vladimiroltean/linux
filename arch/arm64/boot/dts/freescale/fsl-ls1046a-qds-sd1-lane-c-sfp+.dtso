// SPDX-License-Identifier: (GPL-2.0+ OR MIT)
/*
 * Copyright 2024 NXP
 */

/dts-v1/;
/plugin/;

&mac10 { /* DTSEC10/10GEC2 */
	pcsphy-handle = <&pcsphy7>;
	pcs-handle-names = "xfi";
	managed = "in-band-status";
	phys = <&serdes1_lane_c>;
	phy-names = "serdes";
	sfp = <&sfp2>;

	/delete-property/ phy-connection-type;
	/delete-property/ phy-handle;
};

&serdes1 {
	status = "okay";
};
