// SPDX-License-Identifier: (GPL-2.0+ OR MIT)
/*
 * Copyright 2023 NXP
 */
/dts-v1/;
/plugin/;

&dpmac6 {
	phys = <&serdes_1_lane_e>;
	phy-names = "serdes";
	managed = "c73";
};

&pcs_mdio6 {
	status = "okay";
};

&serdes_1 {
	status = "okay";
};
