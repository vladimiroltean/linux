// SPDX-License-Identifier: (GPL-2.0+ OR MIT)
/*
 * Copyright 2023 NXP
 */
/dts-v1/;
/plugin/;

&dpmac4 {
	managed = "c73";
	phys = <&serdes1_lane_e>;
	phy-names = "serdes";
};

&pcs_mdio4 {
	status = "okay";
};

&serdes1 {
	status = "okay";
};
