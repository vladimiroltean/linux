// SPDX-License-Identifier: (GPL-2.0+ OR MIT)
/*
 * Copyright 2023 NXP
 */
/dts-v1/;
/plugin/;

&mac9 { /* DTSEC9/10GEC1 */
	phy-connection-type = "10gbase-kr";
	pcsphy-handle = <&pcsphy6>;
	pcs-handle-names = "c73";
	managed = "c73";
	phys = <&serdes1_lane_d>;
	phy-names = "serdes";
};

&pcsphy6 {
	clocks = <&reg_clk>;
	clock-names = "reg_clk";
};

&serdes1 {
	status = "okay";
};
