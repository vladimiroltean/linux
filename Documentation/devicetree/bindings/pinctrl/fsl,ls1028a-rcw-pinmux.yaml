## Documentation/devicetree/bindings/pinctrl/fsl,lx2160a-rcw-pinmux.yaml
```yaml
# SPDX-License-Identifier: (GPL-2.0-only OR BSD-2-Clause)
%YAML 1.2
---
$id: http://devicetree.org/schemas/pinctrl/fsl,lx2160a-rcw-pinmux.yaml#
$schema: http://devicetree.org/meta-schemas/core.yaml#

title: NXP LX2160A RCW pad muxes

maintainers:
  - Vincent Jardin <vjardin@free.fr>

description:
  The LX2160A muxes its IIC, XSPI, SDHC, UART, IRQ, EVT, EC and USB pads based
  on its RCW. The related fields are from the read-only RCWSR12 to RCWSR14 and
  RCWSR27 registers of DCFG, and can be changed at runtime by writing the RCW
  override registers in the DCSR view of DCFG. The node is a child of the DCFG
  node, which owns both views. Its reg are the RCWSR12 to RCWSR14 and the
  RCWSR27 windows of the CCSR view, and the override registers are at the same
  offsets of the DCSR view.

  Each group is one RCW field, and selecting a function switches all the pads
  of the group at once. Some functions carry the signals of two controllers.
  For example, i2c on sdhc2-data74 gives both IIC7 and IIC8, and flextimer on
  iic2 gives FTM1_CH0 and FTM2_CH0. Such a group has a single owner, so the
  pads of one of those controllers cannot be switched alone, as an I2C bus
  recovery would need.

properties:
  compatible:
    const: fsl,lx2160a-rcw-pinmux

  reg:
    items:
      - description: RCWSR12 to RCWSR14
      - description: RCWSR27

patternProperties:
  '-pins$':
    type: object
    $ref: pinmux-node.yaml#
    additionalProperties: false

    properties:
      function:
        enum: [ asleep, can, clk-out, evt, flexspi, flextimer, gpio, gtx-clk,
                i2c, irq, reset-req, rgmii, sdhc, sdhc-clk, sdhc-data,
                sdhc-data4, sdhc-spi, spi, tsec-1588, uart, uart3, uart4, usb ]

      groups:
        items:
          enum: [ iic1, iic2, iic3, iic4, iic5, iic6, xspi1-data74,
                  xspi1-data30, xspi1-base, sdhc1-base, sdhc1-dir,
                  sdhc2-data74, sdhc2-base, uart1-soutsin, uart1-rtscts,
                  uart2-soutsin, uart2-rtscts, irq11-8, irq7-4, irq3-0,
                  evt4-3, evt2-0, clk-out, asleep, reset-req, ec1, ec2,
                  usb-ext, gtx-clk, sdhc1-ds ]

    required:
      - function
      - groups

    allOf:
      - if:
          properties:
            function:
              const: asleep
        then:
          properties:
            groups:
              items:
                enum: [ asleep ]

      - if:
          properties:
            function:
              const: can
        then:
          properties:
            groups:
              items:
                enum: [ iic3, iic4 ]

      - if:
          properties:
            function:
              const: clk-out
        then:
          properties:
            groups:
              items:
                enum: [ clk-out ]

      - if:
          properties:
            function:
              const: evt
        then:
          properties:
            groups:
              items:
                enum: [ iic3, iic4, evt4-3, evt2-0, asleep ]

      - if:
          properties:
            function:
              const: flexspi
        then:
          properties:
            groups:
              items:
                enum: [ xspi1-data74, xspi1-data30, xspi1-base,
                        sdhc2-data74, sdhc2-base ]

      - if:
          properties:
            function:
              const: flextimer
        then:
          properties:
            groups:
              items:
                enum: [ iic2, irq7-4, irq3-0, evt4-3, evt2-0, clk-out ]

      - if:
          properties:
            function:
              const: gpio
        then:
          properties:
            groups:
              items:
                enum: [ iic2, iic3, iic4, iic5, iic6, xspi1-data74,
                        xspi1-data30, xspi1-base, sdhc1-base, sdhc1-dir,
                        sdhc2-data74, sdhc2-base, uart1-soutsin,
                        uart1-rtscts, uart2-soutsin, uart2-rtscts,
                        irq11-8, irq7-4, irq3-0, evt4-3, evt2-0, clk-out,
                        asleep, reset-req, iic1, ec1, ec2, usb-ext, gtx-clk,
                        sdhc1-ds ]

      - if:
          properties:
            function:
              const: gtx-clk
        then:
          properties:
            groups:
              items:
                enum: [ gtx-clk ]

      - if:
          properties:
            function:
              const: i2c
        then:
          properties:
            groups:
              items:
                enum: [ iic2, iic3, iic4, iic5, iic6, sdhc2-data74, iic1 ]

      - if:
          properties:
            function:
              const: irq
        then:
          properties:
            groups:
              items:
                enum: [ irq11-8, irq7-4, irq3-0 ]

      - if:
          properties:
            function:
              const: reset-req
        then:
          properties:
            groups:
              items:
                enum: [ reset-req ]

      - if:
          properties:
            function:
              const: rgmii
        then:
          properties:
            groups:
              items:
                enum: [ ec1, ec2 ]

      - if:
          properties:
            function:
              const: sdhc
        then:
          properties:
            groups:
              items:
                enum: [ iic2, sdhc1-base, sdhc1-dir, sdhc2-data74,
                        sdhc2-base, sdhc1-ds ]

      - if:
          properties:
            function:
              const: sdhc-clk
        then:
          properties:
            groups:
              items:
                enum: [ iic5, iic6 ]

      - if:
          properties:
            function:
              const: sdhc-data
        then:
          properties:
            groups:
              items:
                enum: [ sdhc1-dir ]

      - if:
          properties:
            function:
              const: sdhc-data4
        then:
          properties:
            groups:
              items:
                enum: [ sdhc1-base ]

      - if:
          properties:
            function:
              const: sdhc-spi
        then:
          properties:
            groups:
              items:
                enum: [ sdhc1-base ]

      - if:
          properties:
            function:
              const: spi
        then:
          properties:
            groups:
              items:
                enum: [ iic5, sdhc1-base, sdhc1-dir, sdhc2-base, sdhc1-ds ]

      - if:
          properties:
            function:
              const: tsec-1588
        then:
          properties:
            groups:
              items:
                enum: [ ec2 ]

      - if:
          properties:
            function:
              const: uart
        then:
          properties:
            groups:
              items:
                enum: [ uart1-soutsin, uart1-rtscts, uart2-soutsin,
                        uart2-rtscts ]

      - if:
          properties:
            function:
              const: uart3
        then:
          properties:
            groups:
              items:
                enum: [ uart1-rtscts ]

      - if:
          properties:
            function:
              const: uart4
        then:
          properties:
            groups:
              items:
                enum: [ uart2-rtscts ]

      - if:
          properties:
            function:
              const: usb
        then:
          properties:
            groups:
              items:
                enum: [ usb-ext ]

required:
  - compatible
  - reg

allOf:
  - $ref: pinctrl.yaml#

unevaluatedProperties: false

examples:
  - |
    pinctrl@12c {
        compatible = "fsl,lx2160a-rcw-pinmux";
        reg = <0x12c 0xc>, <0x168 0x4>;

        iic3-i2c-pins {
            function = "i2c";
            groups = "iic3";
        };

        iic3-gpio-pins {
            function = "gpio";
            groups = "iic3";
        };
    };
```

## Documentation/devicetree/bindings/soc/fsl/fsl,layerscape-dcfg.yaml
```yaml
# SPDX-License-Identifier: (GPL-2.0-only OR BSD-2-Clause)
%YAML 1.2
---
$id: http://devicetree.org/schemas/soc/fsl/fsl,layerscape-dcfg.yaml#
$schema: http://devicetree.org/meta-schemas/core.yaml#

title: Freescale Layerscape Device Configuration Unit

maintainers:
  - Shawn Guo <shawnguo@kernel.org>

description: |
  DCFG is the device configuration unit, that provides general purpose
  configuration and status for the device. Such as setting the secondary
  core start address and release the secondary core from holdoff and
  startup.

properties:
  compatible:
    oneOf:
      - items:
          - enum:
              - fsl,ls1012a-dcfg
              - fsl,ls1021a-dcfg
              - fsl,ls1043a-dcfg
              - fsl,ls1046a-dcfg
              - fsl,ls1088a-dcfg
              - fsl,ls2080a-dcfg
              - fsl,lx2160a-dcfg
          - const: syscon

      - items:
          - enum:
              - fsl,ls1028a-dcfg
              - fsl,lx2160a-dcfg
          - const: syscon
          - const: simple-mfd

  reg:
    minItems: 1
    items:
      - description:
          Customer-visible DCFG register map from CCSR address space
          (Configuration, Control and Status Registers)
      - description:
          Customer-hidden DCFG register map from DCSR address space
          (Debug Control and Status Registers)

  reg-names:
    minItems: 1
    items:
      - const: dcfg_ccsr
      - const: dcfg_dcsr

  little-endian: true
  big-endian: true

  '#address-cells':
    const: 1

  '#size-cells':
    const: 1

  ranges: true

patternProperties:
  "^clock-controller@[0-9a-f]+$":
    $ref: /schemas/clock/fsl,flexspi-clock.yaml#

  "^pinctrl@[0-9a-f]+$":
    $ref: /schemas/pinctrl/fsl,lx2160a-rcw-pinmux.yaml#
    description:
      The pad muxes of the RCW on the LX2160A, at their RCWSR12 to RCWSR14
      and RCWSR27 windows, overridden through the DCSR view of this block.

required:
  - compatible
  - reg

allOf:
  - if:
      not:
        properties:
          compatible:
            contains:
              const: fsl,lx2160a-dcfg
    then:
      patternProperties:
        "^pinctrl@[0-9a-f]+$": false

additionalProperties: false

examples:
  - |
    syscon@1ee0000 {
        compatible = "fsl,ls1021a-dcfg", "syscon";
        reg = <0x1ee0000 0x10000>;
    };
```

## Documentation/devicetree/bindings/soc/fsl/fsl,layerscape-scfg.yaml
```yaml
# SPDX-License-Identifier: (GPL-2.0-only OR BSD-2-Clause)
%YAML 1.2
---
$id: http://devicetree.org/schemas/soc/fsl/fsl,layerscape-scfg.yaml#
$schema: http://devicetree.org/meta-schemas/core.yaml#

title: Freescale Layerscape Supplemental Configuration Unit

maintainers:
  - Shawn Guo <shawnguo@kernel.org>

description: |
  SCFG is the supplemental configuration unit, that provides SoC specific
  configuration and status registers for the chip. Such as getting PEX port
  status.

properties:
  compatible:
    items:
      - enum:
          - fsl,ls1012a-scfg
          - fsl,ls1021a-scfg
          - fsl,ls1028a-scfg
          - fsl,ls1043a-scfg
          - fsl,ls1046a-scfg
          - fsl,ls1088a-isc
          - fsl,ls2080a-isc
          - fsl,lx2160a-isc
      - const: syscon

  reg:
    maxItems: 1

  little-endian: true
  big-endian: true

  '#address-cells':
    const: 1

  '#size-cells':
    const: 1

  ranges: true

patternProperties:
  "^interrupt-controller@[a-f0-9]+$":
    $ref: /schemas/interrupt-controller/fsl,ls-extirq.yaml#

  "^pinctrl@[a-f0-9]+$":
    type: object
    description:
      The pad muxes of the SCFG_RCWPMUXCR0 register, on the LS1043A and the
      LS1046A only.

required:
  - compatible
  - reg

allOf:
  - if:
      properties:
        compatible:
          contains:
            const: fsl,ls1043a-scfg
    then:
      patternProperties:
        "^pinctrl@[a-f0-9]+$":
          $ref: /schemas/pinctrl/fsl,ls1043a-scfg-pinmux.yaml#

  - if:
      properties:
        compatible:
          contains:
            const: fsl,ls1046a-scfg
    then:
      patternProperties:
        "^pinctrl@[a-f0-9]+$":
          $ref: /schemas/pinctrl/fsl,ls1046a-scfg-pinmux.yaml#

  - if:
      not:
        properties:
          compatible:
            contains:
              enum:
                - fsl,ls1043a-scfg
                - fsl,ls1046a-scfg
    then:
      patternProperties:
        "^pinctrl@[a-f0-9]+$": false

additionalProperties: false

examples:
  - |
    syscon@1570000 {
        compatible = "fsl,ls1021a-scfg", "syscon";
        reg = <0x1570000 0x10000>;
    };
```
