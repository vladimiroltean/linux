## Documentation/devicetree/bindings/interrupt-controller/nxp,sja1110-slir.yaml
```yaml
# SPDX-License-Identifier: GPL-2.0
%YAML 1.2
---
$id: http://devicetree.org/schemas/interrupt-controller/nxp,sja1110-slir.yaml#
$schema: http://devicetree.org/meta-schemas/core.yaml#

title: NXP SJA1110 System-Level Interrupt Request

maintainers:
  - Vladimir Oltean <vladimir.oltean@nxp.com>

description: |
  The NXP SJA1110 Ethernet switches contain multiple interrupt multiplexers
  generically named System-Level Interrupt Request (SLIR), in the ACU
  (Auxiliary Control Unit), PMU (Power Management Unit) and GPIO blocks.
  These controllers allow multiplexing internal interrupts from the switch SoC
  (like embedded Ethernet PHYs) towards a single wired IRQ connected to the
  host SoC.

properties:
  compatible:
    items:
      - enum:
          - nxp,sja1110-acu-slir
          - nxp,sja1110-gpio-slir
          - nxp,sja1110-pmu-slir

  reg:
    maxItems: 1
    description:
      Base address and length of the register space (STAT, INTENSET, INTENCLR,
      INTSTAT).

  interrupts:
    maxItems: 1
    description:
      Parent interrupt line connected to the INT_N pin. Can be absent, case in
      which the SLIR is polled.

  '#interrupt-cells':
    const: 1
    description:
      The single cell is the multiplexed internal interrupt number.

  interrupt-controller: true

required:
  - compatible
  - reg
  - '#interrupt-cells'
  - interrupt-controller

additionalProperties: false

examples:
  - |
    #include <dt-bindings/interrupt-controller/irq.h>
    #include <dt-bindings/interrupt-controller/nxp-sja1110-acu-slir.h>

    soc {
        #address-cells = <1>;
        #size-cells = <1>;

        interrupt-controller@1c53e0 {
            compatible = "nxp,sja1110-acu-slir";
            reg = <0x1c53e0 0x10>;
            interrupt-controller;
            #interrupt-cells = <1>;
        };
    };
```

## Documentation/devicetree/bindings/mfd/fsl,ls1028a-qds-qixis.yaml
```yaml
# SPDX-License-Identifier: (GPL-2.0-only OR BSD-2-Clause)
%YAML 1.2
---
$id: http://devicetree.org/schemas/mfd/fsl,ls1028a-qds-qixis.yaml#
$schema: http://devicetree.org/meta-schemas/core.yaml#

title: QIXIS FPGA for NXP LS1028A-QDS

maintainers:
  - Vladimir Oltean <vladimir.oltean@nxp.com>

description: |
  The QIXIS FPGA on the NXP LS1028A-QDS board handles system control
  (boot sources, power sequences and reset signals, signal routing).
  It can be configured by the host CPU through an I2C interface.

properties:
  compatible:
    const: fsl,ls1028a-qds-qixis

  reg:
    description:
      I2C device address.
    maxItems: 1

  "#address-cells":
    const: 1

  "#size-cells":
    const: 0

patternProperties:
  "^mux-controller(@[0-9a-f]+)?$":
    $ref: ../mux/reg-mux.yaml

required:
  - "#address-cells"
  - "#size-cells"
  - compatible
  - reg

additionalProperties: false

examples:
  - |
    #include <dt-bindings/mfd/ls1028a-qds-qixis.h>
    i2c {
        fpga@66 {
            compatible = "fsl,ls1028a-qds-qixis";
            reg = <0x66>;
            #address-cells = <1>;
            #size-cells = <0>;

            mux: mux-controller@54 {
                compatible = "reg-mux";
                reg = <0x54>;
                #mux-control-cells = <1>;
                mux-reg-masks = <QIXIS_BRDCFG(4) 0xf0>; /* bits 7:4 */
            };
        };
    };
```

## drivers/net/dsa/ocelot/Kconfig
```kconfig
# SPDX-License-Identifier: GPL-2.0-only
config NET_DSA_MSCC_FELIX
	tristate "Ocelot / Felix Ethernet switch support"
	depends on NET_DSA && PCI
	depends on NET_DSA_TAG_OCELOT_NPI || NET_DSA_TAG_OCELOT_8021Q
	depends on NET_VENDOR_MICROSEMI
	depends on NET_VENDOR_FREESCALE
	select NET_DSA_TAG_OCELOT_QUIRK_NO_XTR_IRQ if NET_DSA_TAG_OCELOT_8021Q
	select MSCC_OCELOT_SWITCH
	select FSL_ENETC_MDIO
	help
	  This driver supports the VSC9959 network switch, which is a member of
	  the Vitesse / Microsemi / Microchip Ocelot family of switching cores.
	  It is embedded as a PCIe function of the NXP LS1028A ENETC integrated
	  endpoint.

config MSCC_FELIX_SWITCH_TSN
	tristate "TSN on FELIX switch driver"
	depends on NET_DSA_MSCC_FELIX
	depends on TSN
	help
	  This driver supports TSN on felix switch.
```
